## hw/misc/Kconfig
```kconfig
config APPLESMC
    bool
    depends on ISA_BUS

config ARMSSE_CPUID
    bool

config ARMSSE_MHU
    bool

config ARMSSE_CPU_PWRCTRL
    bool

config ISA_DEBUG
    bool
    depends on ISA_BUS

config ISA_TESTDEV
    bool
    default y if TEST_DEVICES
    depends on ISA_BUS

config PCI_TESTDEV
    bool
    default y if TEST_DEVICES
    depends on PCI

config IOMMU_TESTDEV
    bool
    default y if TEST_DEVICES
    depends on PCI

config EDU
    bool
    default y if TEST_DEVICES
    depends on PCI && MSI_NONBROKEN

config I2C_ECHO
    bool
    default y if TEST_DEVICES
    depends on I2C

config PL310
    bool

config INTEGRATOR_DEBUG
    bool

config A9SCU
    bool

config ARM11SCU
    bool

config MAX78000_AES
    bool

config MAX78000_GCR
    bool

config MAX78000_ICC
    bool

config MAX78000_TRNG
    bool

config MOS6522
    bool

config MACIO
    bool
    select CUDA
    select ESCC
    select IDE_MACIO
    select MAC_DBDMA
    select MAC_NVRAM
    select MOS6522

config IVSHMEM_DEVICE
    bool
    default y if PCI_DEVICES
    depends on PCI && LINUX && IVSHMEM && MSI_NONBROKEN

config IVSHMEM_FLAT_DEVICE
    bool
    default y
    depends on LINUX && IVSHMEM

config ECCMEMCTL
    bool

config IMX
    bool
    select PTIMER
    select SSI
    select USB_EHCI_SYSBUS

config FSL_IMX8MP_ANALOG
    bool

config FSL_IMX8MP_CCM
    bool

config STM32_RCC
    bool

config STM32F2XX_SYSCFG
    bool

config STM32F4XX_SYSCFG
    bool

config STM32F4XX_EXTI
    bool

config STM32L4X5_EXTI
    bool

config STM32L4X5_SYSCFG
    bool

config STM32L4X5_RCC
    bool

config MIPS_ITU
    bool
    depends on TCG

config RISCV_MIPS_CMGCR
    bool

config RISCV_MIPS_CPC
    bool

config RISCV_MIPS_CPS
    bool

config MPS2_FPGAIO
    bool
    select LED

config MPS2_SCC
    bool
    select LED

config TZ_MPC
    bool

config TZ_MSC
    bool

config TZ_PPC
    bool

config IOTKIT_SECCTL
    bool

config IOTKIT_SYSCTL
    bool

config IOTKIT_SYSINFO
    bool

config PVPANIC_COMMON
    bool

config PVPANIC_PCI
    bool
    default y if PCI_DEVICES
    depends on PCI
    select PVPANIC_COMMON

config PVPANIC_ISA
    bool
    depends on ISA_BUS
    select PVPANIC_COMMON

config PVPANIC_MMIO
    bool
    select PVPANIC_COMMON

config AUX
    bool
    select I2C

config UNIMP
    bool

config LED
    bool

config MAC_VIA
    bool
    select MOS6522
    select ADB

config AVR_POWER
    bool

config MCHP_PFSOC_DMC
    bool

config MCHP_PFSOC_IOSCB
    bool

config MCHP_PFSOC_SYSREG
    bool

config SIFIVE_TEST
    bool

config SIFIVE_E_PRCI
    bool

config SIFIVE_E_AON
    bool

config SIFIVE_U_OTP
    bool

config SIFIVE_U_PRCI
    bool

config VIRT_CTRL
    bool

config LASI
    bool
    select LASI_82596
    select LASIPS2
    select NCR710_SCSI
    select PARALLEL
    select SERIAL_MM

config ALLWINNER_SRAMC
    bool

config ALLWINNER_A10_CCM
    bool

config ALLWINNER_A10_DRAMC
    bool

config AXP2XX_PMU
    bool
    depends on I2C

config DJMEMC
    bool

config IOSB
    bool

config XLNX_VERSAL_TRNG
    bool

config XLNX_ZYNQ_DDRC
    bool

source macio/Kconfig

config MCXN_SCG
    bool

config IMXRT1180_ANADIG
    bool

config IMXRT1180_RTWDOG
    bool

config IMXRT1180_S3MU
    bool

config IMXRT1180_CCM
    bool

config IMXRT1180_SRC
    bool

config IMXRT1180_TRDC
    bool

config IMXRT1180_MU
    bool

config MCXN_SYSCON
    bool

config MCXN_PORT
    bool

config MCXN_SPC
    bool

config MCXN_STUB
    bool

config MCXN_CRC
    bool

config MCXN_CDOG
    bool

config MCXN_EWM
    bool

config MCXN_INPUTMUX
    bool

config MCXN_EVTG
    bool

config MCXN_PLU
    bool

config MCXN_FREQME
    bool

config MCXN_GDET
    bool

config MCXN_ITRC
    bool

config MCXN_TDET
    bool

config MCXN_CMC
    bool

config MCXN_EIM
    bool

config MCXN_ERM
    bool

config MCXN_INTM
    bool

config MCXN_FMU
    bool

config MCXN_CMX_PERFMON
    bool

config MCXN_SEMA42
    bool

config MCXN_MAILBOX
    bool

config MCXN_VBAT
    bool

config MCXN_WUU
    bool

config MCXN_OTPC
    bool

config MCXN_CACHE64_CTRL
    bool

config MCXN_AHBSC
    bool

config MCXN_BSP32
    bool

config MCXN_DM
    bool

config MCXN_PINT
    bool

config MCXN_UTICK
    bool

config MCXN_WWDT
    bool

config MCXN_OPAMP
    bool

config MCXN_CMP
    bool

config MCXN_VREF
    bool

config MCXN_ELS
    bool

config MCXN_PUF
    bool

config MCXN_PKC
    bool

config MCXN_TRDC
    bool

config MCXN_DAC
    bool

config MCXN_SINC
    bool

config MCXN_PDM
    bool

config MCXN_EMVSIM
    bool

config MCXN_I3C
    bool

config MCXN_FLEXIO
    bool

config MCXN_FLEXCAN
    bool

config MCXN_ENET
    bool

config MCXN_ADC
    bool

config MCXN_RTC
    bool

config MCXN_TSI
    bool

config MCXN_SAI
    bool

config MCXN_USDHC
    bool

config MCXN_FLEXSPI
    bool

config MCXN_PWM
    bool

config MCXN_QDC
    bool

config MCXN_SCT
    bool

config MCXN_USBFS
    bool

config MCXN_USBDCD
    bool

config MCXN_USBPHY
    bool

config MCXN_USBHS
    bool

config MCXN_SMARTDMA
    bool

config MCXN_POWERQUAD
    bool

config MCXN_NPU
    bool

config MCXN_NEUTRON
    bool

config IMXRT1180_FLEXCAN
    bool
    select CAN_BUS

config IMXRT1180_SAI
    bool

config IMXRT1180_USBPHY
    bool

config IMXRT1180_PWM
    bool

config IMXRT1180_EQDC
    bool

config IMXRT1180_ADC
    bool

config IMXRT1180_XBAR
    bool

config IMXRT1180_MOTOR
    bool

config IMXRT1180_TMR
    bool

config IMXRT1180_VREF
    bool

config IMXRT1180_PERIPHRDY
    bool

config IMXRT1180_CMP
    bool

config IMXRT1180_SEMA42
    bool

config IMXRT1180_TPM
    bool

config IMXRT1180_GPT
    bool

config IMXRT1180_LPTMR
    bool
```
